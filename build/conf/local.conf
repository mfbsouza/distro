## build/conf/local.conf
```bitbake
MACHINE ?= "qemux86-64"

MACHINE_FEATURES:append = " \
    acpi \
    efi \
    pci \
    usbhost \
    screen \
    keyboard"

MACHINE_FEATURES:remove = " \
    bluetooth \
    alsa \
    wifi"

DL_DIR ?= "${TOPDIR}/../downloads"

SSTATE_DIR ?= "${TOPDIR}/../sstate-cache/${MACHINE}"

DISTRO ?= "poky"

DISTRO_FEATURES:append = " \
    systemd"

DISTRO_FEATURES:remove = " \
    alsa \
    bluetooth \
    wifi \
    pulseaudio \
    bluez5 \
    ssh-server-dropbear \
    wayland \
    x11 \
    vulkan \
    opengl \
    nfc"

VIRTUAL-RUNTIME_init_manager = "systemd"
DISTRO_FEATURES_BACKFILL_CONSIDERED:append = " sysvinit"
VIRTUAL-RUNTIME_initscripts = "systemd-compat-units"

PACKAGE_CLASSES ?= "package_rpm"

USER_CLASSES ?= "buildstats"

PATCHRESOLVE = "noop"

BB_DISKMON_DIRS ??= "\
    STOPTASKS,${TMPDIR},1G,100K \
    STOPTASKS,${DL_DIR},1G,100K \
    STOPTASKS,${SSTATE_DIR},1G,100K \
    STOPTASKS,/tmp,100M,100K \
    HALT,${TMPDIR},100M,1K \
    HALT,${DL_DIR},100M,1K \
    HALT,${SSTATE_DIR},100M,1K \
    HALT,/tmp,10M,1K"

PACKAGECONFIG:append:pn-qemu-system-native = " sdl"

CONF_VERSION = "2"
```

## layers/meta-os/conf/distro/example.conf
```bitbake
# list of providers for some distro components
# TODO: maybe this is not needed
include conf/distro/include/default-providers.inc

# vars like locale and distro features
# TODO: create my own distrovars in the include folder
include conf/distro/include/default-distrovars.inc

# list of recipe maintainers
# TODO: this is probably not needed
include conf/distro/include/maintainers.inc

# distro info
DISTRO = "mydistro"
DISTRO_NAME = "mydistro name is here"
DISTRO_VERSION = "0.1.0"
MAINTAINER = "Matheus Souza <mfbsouza.it@gmail.com>"

# c library configuration
TCLIBC = "musl"
TCLIBCAPPEND ?= "-${TCLIBC}"
TMPDIR .= "${TCLIBCAPPEND}"
require conf/distro/include/tclibc-${TCLIBC}.inc
require conf/distro/include/tcmode-${TCMODE}.inc
require conf/distro/include/uninative-flags.inc

# init manager configuration
INIT_MANAGER ?= "mdev-busybox"
require conf/distro/include/init-manager-${INIT_MANAGER}.inc

# package configuration
PACKAGE_CLASSES ?= "package_ipk"

# disable static libs
require conf/distro/include/no-static-libs.inc

INHERIT_DISTRO ?= "debian devshell sstate license remove-libtool"
INHERIT += "${PACKAGE_CLASSES} ${USER_CLASSES} ${INHERIT_DISTRO}"
```

## layers/meta-os/conf/layer.conf
```bitbake
# We have a conf and classes directory, add to BBPATH
BBPATH .= ":${LAYERDIR}"

# We have recipes-* directories, add to BBFILES
BBFILES += "${LAYERDIR}/recipes-*/*/*.bb \
            ${LAYERDIR}/recipes-*/*/*.bbappend"

BBFILE_COLLECTIONS += "meta-os"
BBFILE_PATTERN_meta-os = "^${LAYERDIR}/"
BBFILE_PRIORITY_meta-os = "6"

LAYERDEPENDS_meta-os = "core"
LAYERSERIES_COMPAT_meta-os = "kirkstone"
```
